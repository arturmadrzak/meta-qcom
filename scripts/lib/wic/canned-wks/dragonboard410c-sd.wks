## scripts/lib/wic/canned-wks/dragonboard410c-sd.wks
```
# short-description: Create an SD card image with LittleKernel
# long-description: Creates partitioned SD card image for Dragonboard 410c
# that user can directly dd into card and run distro from externa memory

part --size 1M  --no-table
part --size 512K  --label sbl1  --part-type DEA0BA2C-CBDD-4805-B4F9-F428251C3E98 --source rawcopy --sourceparams "file=sbl1.mbn" --align 65536
part --size 512K  --label rpm   --part-type 098DF793-D712-413D-9D4E-89D711772228 --source rawcopy --sourceparams "file=rpm.mbn"
part --size 1024K --label tz    --part-type A053AA7F-40B8-4B1C-BA08-2F68AC71A4F4 --source rawcopy --sourceparams "file=tz.mbn"
part --size 512K  --label hyp   --part-type E1A6A689-0C8D-4CC6-B4E8-55A4320FBD8A --source rawcopy --sourceparams "file=hyp.mbn"
part --size 16K   --label sec   --part-type 303E6AC3-AF15-4C54-9E9B-D9A8FBECF401 --align 65536
part --size 1024K --label aboot --part-type 400FFDCD-22E0-47E7-9A23-F16ED9382388 --source rawcopy --sourceparams "file=emmc_appsboot.mbn"
part /boot --size 64M   --label boot  --part-type 20117F86-E985-4357-B9EE-374BC1D8487D --source rawcopy --sourceparams "file=boot-sd-dragonboard-410c.img"
part --size 1024K --label devinfo --part-type 1B81E7E6-F50D-419B-A739-2AEEF8DA3335
part /  --fstype=ext4 --source rootfs --label "rootfs"

bootloader --ptable gpt
```
